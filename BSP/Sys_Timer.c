
/*********************************************************************************
//概述：
//作者：随风飘跃     时间：       地点：
//CPU型号：         系统主频：
//版本号：V0.0        
*********************************************************************************/
/*********************************************************************************
文件包含区
*********************************************************************************/
#include "Sys_timer.h"  
/*********************************************************************************
常量定义区
*********************************************************************************/

/*********************************************************************************
公共变量定义区
*********************************************************************************/
/*********************************************************************************
外部变量声明区
*********************************************************************************/
/*********************************************************************************
私有变量定义区
*********************************************************************************/ 
NEAR static struct Str_Sys_Timer Sys_Timer[SYS_TIMER_NUMBER];//系统使用函数定义
/*********************************************************************************
测试变量定义区
*********************************************************************************/
/*********************************************************************************
内部函数定义区
*********************************************************************************/
/*********************************************************************************
功能代码定义区
*********************************************************************************/
/*********************************************************************************
 Function:      //
 Description:   //
 Input:         //
                //
 Output:        //
 Return:      	//
 Others:        //
*********************************************************************************/
void SysTick_Handler(void)                                                     //滴答中断服务函数
{
  static unsigned char Timer_Num=0;
  for(Timer_Num=0;Timer_Num<SYS_TIMER_NUMBER-1;Timer_Num++)
  {
    if(Sys_Timer[Timer_Num].Start != DISABLE)//判断开始的定时器
    {
      if(Sys_Timer[Timer_Num].Counter >= Sys_Timer[Timer_Num].Duration)
      {
        switch(Sys_Timer[Timer_Num].Mode)
        {
        case ONCE:  //单次执行
          {
            Sys_Timer[Timer_Num].Start = DISABLE;//定时器关闭
          }
          break;
        case CONTINUOUSS://连续执行
          {
            //一直运行
          }
          break;
        case SET_TIME://设置的次数
          {
            Sys_Timer[Timer_Num].Run_Nuber--;
            if(Sys_Timer[Timer_Num].Run_Nuber == 0)//达到次数则关闭
            {
              Sys_Timer[Timer_Num].Start = DISABLE;//定时器关闭
            }
          }
          break;
        default:
        break;     
        }
        if(Sys_Timer[Timer_Num].Run_Mode == INTERRUPT2)//中断执行函数
        {
          Sys_Timer[Timer_Num].Call_Back();//执行定时的函数
        }
        else
        {
          Sys_Timer[Timer_Num].Pend = ENABLE;
        }
        Sys_Timer[Timer_Num].Counter = 0;
      }
      else
      {
        Sys_Timer[Timer_Num].Counter++;
      }
    }
  }
}
/*********************************************************************************
 Function:      //
 Description:   //
 Input:         //
                //
 Output:        //
 Return:		    //
 Others:        //
*********************************************************************************/
ErrorStatus Create_Timer(enum Sys_Mode_En Mode,unsigned long Duration,
                         void (*Call_Back)(void),unsigned short Run_Nuber,
                         enum Sys_Run_Mode_En Run_Mode)
{
  ErrorStatus err = SUCCESS;
  unsigned char i=0;
  Delete_Timer(Call_Back);//创建之前先删除相同进程
  for(i=0;i<SYS_TIMER_NUMBER-1;i++)
  {
    if(Sys_Timer[i].Start == DISABLE)//找到一个空闲的定时器
    {
      Sys_Timer[i].Duration = Duration;
      Sys_Timer[i].Counter = 0;
      Sys_Timer[i].Mode = Mode;
      Sys_Timer[i].Call_Back = Call_Back;
      Sys_Timer[i].Run_Nuber = Run_Nuber;
      Sys_Timer[i].Start = ENABLE;
      Sys_Timer[i].Pend = DISABLE;
      Sys_Timer[i].Run_Mode = Run_Mode;
      break;
    }
  }
  if(i==SYS_TIMER_NUMBER-1)//定时器溢出
    err = ERROR;
  return err;
}
/*********************************************************************************
 Function:      //
 Description:   //
 Input:         //
                //
 Output:        //
 Return:		    //
 Others:        //
*********************************************************************************/
ErrorStatus Delete_Timer(void (*Call_Back)(void))
{
  ErrorStatus err = ERROR;
  unsigned char i;
  for(i=0;i<SYS_TIMER_NUMBER-1;i++)
  {
    if(Sys_Timer[i].Call_Back == Call_Back)//找到相同的执行程序，然后删除
    {
      Sys_Timer[i].Start = DISABLE;
      Sys_Timer[i].Pend = DISABLE;
      err = SUCCESS;
    }
  }
  return err;
}
/*********************************************************************************
 Function:      //
 Description:   //
 Input:         //
                //
 Output:        //
 Return:		    //
 Others:        //
*********************************************************************************/
void Sys_Timer_Process(void)
{
  unsigned char i;
  for(i=0;i<SYS_TIMER_NUMBER-1;i++)
  {
    if(Sys_Timer[i].Pend == ENABLE)                       //判断需要执行的程序
    {
      Sys_Timer[i].Pend = DISABLE;
      Sys_Timer[i].Call_Back();//执行定时的函数
    }
  }
}
/*********************************************************************************
 Function:      //
 Description:   //
 Input:         //
                //
 Output:        //
 Return:      	//
 Others:        //
*********************************************************************************/
/*********************************************************************************
 Function:      //
 Description:   //
 Input:         //
                //
 Output:        //
 Return:		    //
 Others:        //
*********************************************************************************/

/*********************************************************************************
 Function:      //
 Description:   //
 Input:         //
                //
 Output:        //
 Return:		    //
 Others:        //
*********************************************************************************/

/*********************************************************************************
 Function:      //
 Description:   //
 Input:         //
                //
 Output:        //
 Return:		    //
 Others:        //
*********************************************************************************/

/*********************************************************************************
 Function:      //
 Description:   //
 Input:         //
                //
 Output:        //
 Return:		    //
 Others:        //
*********************************************************************************/

/*********************************************************************************
 Function:      //
 Description:   //
 Input:         //
                //
 Output:        //
 Return:		//
 Others:        //
*********************************************************************************/

/*********************************************************************************
 Function:      //
 Description:   //
 Input:         //
                //
 Output:        //
 Return:		//
 Others:        //
*********************************************************************************/

/*********************************************************************************
 Function:      //
 Description:   //
 Input:         //
                //
 Output:        //
 Return:		//
 Others:        //
*********************************************************************************/

/*********************************************************************************
 Function:      //
 Description:   //
 Input:         //
                //
 Output:        //
 Return:	//
 Others:        //
*********************************************************************************/
/*********************************************************************************
 Function:      //
 Description:   //
 Input:         //
                //
 Output:        //
 Return:	     	//
 Others:        //
*********************************************************************************/
/*********************************************************************************
 Function:      //
 Description:   //
 Input:         //
                //
 Output:        //
 Return:		//
 Others:        //
*********************************************************************************/
/*********************************************************************************
 Function:      //
 Description:   //
 Input:         //
                //
 Output:        //
 Return:		//
 Others:        //
*********************************************************************************/
/*********************************************************************************
 Function:      //
 Description:   //
 Input:         //
                //
 Output:        //
 Return:		//
 Others:        //
*********************************************************************************/
/*********************************************************************************
 Function:      //
 Description:   //
 Input:         //
                //
 Output:        //
 Return:		//
 Others:        //
*********************************************************************************/
/*********************************************************************************
 Function:      //
 Description:   //
 Input:         //
                //
 Output:        //
 Return:		//
 Others:        //
*********************************************************************************/
/******************************************END********************************************************/
