/*********************************************************************************
文件包含区
*********************************************************************************/
#include "include.h"
/*********************************************************************************
常量定义区
*********************************************************************************/
const unsigned short Temp_Table[166] =  //温度参数表
{
  3897 ,3887 ,3877 ,3865 ,3852 ,3837 ,3825 ,3812 ,3798 ,3782 , //-40~-31
  3764 ,3749 ,3734 ,3716 ,3697 ,3676 ,3659 ,3640 ,3620 ,3597 , //-30~-21
  3572 ,3552 ,3530 ,3507 ,3481 ,3452 ,3429 ,3404 ,3377 ,3348 , //-20~-11
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  230 ,226 ,221 ,216 ,211 ,207 //120~125
};
/*********************************************************************************
公共变量定义区
*********************************************************************************/
/*********************************************************************************
外部变量声明区
*********************************************************************************/
/*********************************************************************************
私有变量定义区
*********************************************************************************/ 

/*********************************************************************************
测试变量定义区
*********************************************************************************/
/*********************************************************************************
内部函数定义区
*********************************************************************************/

/*********************************************************************************
功能代码定义区
*********************************************************************************/
/*********************************************************************************
 Function:      //
 Description:   //
 Input:         //
                //
 Output:        //
 Return:      	//
 Others:        //
*********************************************************************************/
signed char Read_Temp(void)
{
  unsigned short ADC_Data = 0;
  unsigned char i;
  signed char temp = 0;
   
  GPIO_Init(GPIOA, GPIO_Pin_4,  GPIO_Mode_Out_PP_High_Fast);         // 热敏电阻
  GPIO_Init(GPIOA, GPIO_Pin_5,  GPIO_Mode_In_FL_No_IT);      // 热敏电阻ADC检测端
        
  CLK_PeripheralClockConfig(CLK_Peripheral_ADC1, ENABLE);   //开启ADC时钟
  ADC_Init (ADC1,ADC_ConversionMode_Continuous, 
                                          ADC_Resolution_12Bit, ADC_Prescaler_1 );         //断续模式 12位 1分频
  ADC_ChannelCmd(ADC1,ADC_Channel_1,ENABLE );         //通道选择1

  ADC_SamplingTimeConfig (ADC1,ADC_Group_FastChannels,ADC_SamplingTime_4Cycles);

  
  ADC_ChannelCmd(ADC1,ADC_Channel_1,ENABLE);//开启通道
  ADC_Cmd (ADC1, ENABLE);                                   //开启ADC外围
  ADC_SoftwareStartConv (ADC1);                             //ADC开始转换
  while(RESET == ADC_GetFlagStatus(ADC1, ADC_FLAG_EOC));    //检测ADC是否转换结束
  ADC_ClearFlag (ADC1,ADC_FLAG_EOC );                       //清除转换结束标志
  ADC_ChannelCmd(ADC1,ADC_Channel_1,DISABLE);//关闭通道
  ADC_Cmd(ADC1, DISABLE);                                   //关闭ADC外围
  ADC_Data =  ADC_GetConversionValue(ADC1);                 //获取ADC值
  CLK_PeripheralClockConfig(CLK_Peripheral_ADC1, DISABLE);   //关闭ADC时钟
  for(i=0;i<166;i++)
  {
    if(Temp_Table[i] <= ADC_Data)
    break;
  }

  temp = (signed char)i - 40-1;
  if(temp < 0)
  {
    MeterParameter.Temp = ~(abs(temp)-1);
  }
  else
  {
    MeterParameter.Temp = temp;
  }
  return temp;
}
/*********************************************************************************
 Function:      //
 Description:   //
 Input:         //
                //
 Output:        //
 Return:      	//
 Others:        //
*********************************************************************************/

/*********************************************************************************
 Function:      //
 Description:   //
 Input:         //
                //
 Output:        //
 Return:      	//
 Others:        //
*********************************************************************************/

/*********************************************************************************
 Function:      //
 Description:   //
 Input:         //
                //
 Output:        //
 Return:      	//
 Others:        //
*********************************************************************************/


/*********************************************************************************
 Function:      //
 Description:   //
 Input:         //
                //
 Output:        //
 Return:      	//
 Others:        //
*********************************************************************************/
  
/*********************************************************************************
 Function:      //
 Description:   //
 Input:         //
                //
 Output:        //
 Return:        //
 Others:        //
*********************************************************************************/

/*********************************************************************************
 Function:      //
 Description:   //
 Input:         //
                //
 Output:        //
 Return:        //
 Others:        //
*********************************************************************************/

/*********************************************************************************
 Function:      //
 Description:   //
 Input:         //
                //
 Output:        //
 Return:        //
 Others:        //
*********************************************************************************/

/******************************************END********************************************************/