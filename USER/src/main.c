/*********************************************************************************
//概述：
//作者：随风飘跃     时间：       地点：
//CPU型号：         系统主频：
//版本号：V0.0        
*********************************************************************************/
/*********************************************************************************
文件包含区
*********************************************************************************/
#include "include.h"
/*********************************************************************************
常量定义区
*********************************************************************************/
/*********************************************************************************
公共变量定义区
*********************************************************************************/
/*********************************************************************************
外部变量声明区
*********************************************************************************/
/*********************************************************************************
私有变量定义区
*********************************************************************************/ 
/*********************************************************************************
测试变量定义区
*********************************************************************************/
/*********************************************************************************
内部函数定义区
*********************************************************************************/
/*********************************************************************************
功能代码定义区
*********************************************************************************/
/*********************************************************************************
 Function:      //
 Description:   //
 Input:         //
                //
 Output:        //
 Return:      	//
 Others:        //
*********************************************************************************/
void main(void)
{ 
  disableInterrupts();                                      //关总中断
  MCU_Config();
  Rtc_Config();
  Set_Alarm();
  Pulse_Acquire_Config();
  Debug_Config();
  enableInterrupts();                                       //开总中断
///////////////////////////////////////////////////////// 
  Read_Meter_Parameter();                               //读取水表参数
  Save_DebugResetRecord();
/////////////////////////////////////////////////////////   
  while(1)
  {
   
    IWDG_ReloadCounter();//重载看门狗计数器

    Magnetic_Interference_Detection();  //磁干扰检测
    
    if(MeterParameter.Mode.All == SLEEP)     //设备进入睡眠状态
    {
      Sleep();
    }  
    else
    {
      Sys_Timer_Process();
      BC95_Process(); 
      Debug_Process();
      Event_Process();
    }
  }
}
/*********************************************************************************
 Function:      //
 Description:   //事件进程
 Input:         //
 Output:        //
 Return:      	//
 Others:        //
*********************************************************************************/
void Event_Process(void)
{
  //上传数据
  if(MeterParameter.Event.bc95 != FREE)
  {
    MeterParameter.Event.bc95 = FREE;
    Save_DebugReportStatistics(0);      //启动次数+1
    Save_DebugReportRecord(0);           //保存启动时间
    Save_Add_Flow(ADD_FLOW_ADD,&Cal.Water_Data);       //保存当前水量
    BC95_Power_On();
  }
  
  //采样数据
  if(MeterParameter.Event.eeprom != FREE)
  {
    MeterParameter.Event.eeprom = FREE;
    Save_History_Data();    //保存本次数据
    MeterParameter.Mode.eeprom = SLEEP;
  }
  
  //调试数据
  if(MeterParameter.Event.debug != FREE)
  {
    MeterParameter.Event.debug = FREE;
    Debug_Init();
  }
}
/*********************************************************************************
 Function:      //
 Description:   //
 Input:         //
                //
 Output:        //
 Return:      	//
 Others:        //
*********************************************************************************/

/*********************************************************************************
 Function:      //
 Description:   //
 Input:         //
                //
 Output:        //
 Return:      	//
 Others:        //
*********************************************************************************/

