/*********************************************************************************
文件包含区
*********************************************************************************/
#include "include.h"
/*********************************************************************************
常量定义区
*********************************************************************************/
/*********************************************************************************
公共变量定义区
*********************************************************************************/
RTC_TimeTypeDef   RTC_TimeStr;        //RTC时间结构体
RTC_DateTypeDef   RTC_DateStr;        //RTC日期结构体
struct Meter_Parameter_EN MeterParameter;
struct History_Data_EN HistoryData;
//unsigned short ADC1SampleBuffer[ADC1_SAMPLE_BUFFER_SIZE];
/*********************************************************************************
外部变量声明区
*********************************************************************************/

/*********************************************************************************
私有变量定义区
*********************************************************************************/ 
/*********************************************************************************
测试变量定义区
*********************************************************************************/
/*********************************************************************************
内部函数定义区
*********************************************************************************/
/*********************************************************************************
功能代码定义区
*********************************************************************************/
unsigned char Int_to_ASCLL(unsigned char data)
{
  unsigned char value = 0;
  
  if( data <= 9 )
  {
          value = data + '0';
  }
  else
  {
          value = data + 'A' - 10;
  }
  return value;
}

/*********************************************************************************
 Function:      //
 Description:   //
 Input:         //
                //
 Output:        //
 Return:      	//
 Others:        //
*********************************************************************************/
unsigned char ASCLL_to_Int(unsigned char data)
{
  unsigned char value = 0;
  if(data >= '0' && data <= '9')
    value = data - '0';
  else if(data >= 'A' && data <= 'F')
    value = data - 'A' + 10;
  else if(data >= 'a' && data <= 'f')
    value = data - 'a' + 10;
  else value = data;
  return value;
}
/*********************************************************************************
 Function:      //
 Description:   //
 Input:         //
                //
 Output:        //
 Return:      	//
 Others:        //
*********************************************************************************/
unsigned char BCD_to_Int(unsigned char data)
{
  return (data/16*10+data%16);
}
/*********************************************************************************
 Function:      //
 Description:   //在字符串str的前len个长度中查找字符串str2第一次出现的位置
 Input:         //
                //
 Output:        //
 Return:      	//
 Others:        //
*********************************************************************************/
char* strnstr(char* str1,char* str2,unsigned char len)
{
  unsigned short len1 = 0;
  unsigned short len2 = 0;
  
  len1 = strlen(str1);
  len2 = strlen(str2);
  if(len2 == 0)
  {
    return str1;
  }
  len = (len>len1)?len1:len;
  while(len >= len2)
  {
    if(memcmp(str1,str2,len2) == 0)
    {
      return str1;
    }
    len--;
    str1++;
  }
  return NULL;
}

/*********************************************************************************
 Function:      //
 Description:   //
 Input:         //
                //
 Output:        //
 Return:      	//
 Others:        //
*********************************************************************************/

